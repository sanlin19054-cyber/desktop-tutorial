#include "oled.h"
#include "main.h"
#include "i2c.h"
#include "stm32f1xx_hal.h"

#include <stdint.h>
#include <string.h>

/* 如果 i2c.h 里没有声明 hi2c1，就在这里声明 */
extern I2C_HandleTypeDef hi2c1;


/*==========================================================
  SSD1306 底層寫命令
==========================================================*/
static void OLED_WriteCommand(uint8_t command)
{
    uint8_t data[2];

    data[0] = 0x00;      // Co=0, D/C#=0
    data[1] = command;

    HAL_I2C_Master_Transmit(
        &hi2c1,
        OLED_ADDR,
        data,
        2,
        100
    );
}


/*==========================================================
  SSD1306 底層寫資料
==========================================================*/
static void OLED_WriteData(uint8_t *data, uint16_t size)
{
    uint8_t buffer[129];

    buffer[0] = 0x40;    // Co=0, D/C#=1

    if(size > 128)
    {
        size = 128;
    }

    memcpy(&buffer[1], data, size);

    HAL_I2C_Master_Transmit(
        &hi2c1,
        OLED_ADDR,
        buffer,
        size + 1,
        100
    );
}


/*==========================================================
  OLED 初始化
==========================================================*/
void OLED_Init(void)
{
    HAL_Delay(100);

    OLED_WriteCommand(0xAE); // Display OFF

    OLED_WriteCommand(0x20); // Set Memory Addressing Mode
    OLED_WriteCommand(0x00); // Horizontal addressing mode

    OLED_WriteCommand(0xB0); // Page 0

    OLED_WriteCommand(0xC8); // COM scan direction

    OLED_WriteCommand(0x00); // Lower column start
    OLED_WriteCommand(0x10); // Higher column start

    OLED_WriteCommand(0x40); // Start line 0

    OLED_WriteCommand(0x81); // Contrast
    OLED_WriteCommand(0x7F);

    OLED_WriteCommand(0xA1); // Segment remap

    OLED_WriteCommand(0xA6); // Normal display

    OLED_WriteCommand(0xA8); // Multiplex ratio
    OLED_WriteCommand(0x3F);

    OLED_WriteCommand(0xD3); // Display offset
    OLED_WriteCommand(0x00);

    OLED_WriteCommand(0xD5); // Display clock
    OLED_WriteCommand(0x80);

    OLED_WriteCommand(0xD9); // Pre-charge
    OLED_WriteCommand(0xF1);

    OLED_WriteCommand(0xDA); // COM pins
    OLED_WriteCommand(0x12);

    OLED_WriteCommand(0xDB); // VCOMH
    OLED_WriteCommand(0x40);

    OLED_WriteCommand(0x8D); // Charge pump
    OLED_WriteCommand(0x14);

    OLED_WriteCommand(0xAF); // Display ON

    OLED_Clear();
}


/*==========================================================
  清屏
==========================================================*/
void OLED_Clear(void)
{
    uint8_t zero[128];

    memset(zero, 0x00, sizeof(zero));

    for(uint8_t page = 0; page < 8; page++)
    {
        OLED_WriteCommand(0xB0 + page);
        OLED_WriteCommand(0x00);
        OLED_WriteCommand(0x10);

        OLED_WriteData(zero, 128);
    }
}


/*==========================================================
  5x7 ASCII 字庫
==========================================================*/

static const uint8_t Font5x7[95][5] =
{
    {0x00,0x00,0x00,0x00,0x00}, /* space */
    {0x00,0x00,0x5F,0x00,0x00},
    {0x00,0x07,0x00,0x07,0x00},
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    {0x10,0x08,0x08,0x10,0x08}
};


/*==========================================================
  顯示 ASCII 字符串
==========================================================*/
void OLED_ShowString(uint8_t x,
                     uint8_t y,
                     char *str)
{
    uint8_t i;
    uint8_t page;

    page = y / 8;

    OLED_WriteCommand(0xB0 + page);

    OLED_WriteCommand(0x00 + (x & 0x0F));
    OLED_WriteCommand(0x10 + ((x >> 4) & 0x0F));

    while(*str)
    {
        char c = *str;

        if(c < 32 || c > 126)
        {
            c = '?';
        }

        for(i = 0; i < 5; i++)
        {
            uint8_t column = Font5x7[c - 32][i];

            OLED_WriteData(&column, 1);
        }

        /* 字符间留一个空列 */
        {
            uint8_t space = 0x00;

            OLED_WriteData(&space, 1);
        }

        str++;
    }
}