#include "avoidance.h" 
#include "motor.h" 
#include "hc_sr04.h" 

/*==========================================================
  避障参数
==========================================================*/

/* 前方障碍物判断距离 */
#define FRONT_LIMIT             20U

/* 左右障碍物判断距离 */
#define SIDE_LIMIT              15U

/* 非常近的障碍物 */
#define VERY_CLOSE               8U

/* 电机速度 */
#define GO_SPEED                50
#define BACK_SPEED              40
#define TURN_SPEED              50

/* 时间参数，单位 ms */
#define STOP_TIME               80U
#define BACK_TIME              250U
#define TURN_TIME              250U
#define ESCAPE_TIME            300U


/*==========================================================
  上一次转向方向

  0 = 尚未转向
  1 = 上一次左转
  2 = 上一次右转
==========================================================*/
static uint8_t last_turn = 0;


/*==========================================================
  简单随机数
==========================================================*/

static uint32_t random_seed = 0x13572468;


/*==========================================================
  产生随机方向

  返回：
  0 = 左转
  1 = 右转
==========================================================*/
static uint8_t Avoidance_RandomDirection(void)
{
    /*
     * Xorshift32
     *
     * 不需要额外 rand() 库
     */
    random_seed ^= random_seed << 13;
    random_seed ^= random_seed >> 17;
    random_seed ^= random_seed << 5;

    return (uint8_t)(random_seed & 0x01U);
}


/*==========================================================
  随机选择转向
==========================================================*/
static void Avoidance_TurnRandom(void)
{
    uint8_t direction;


    direction = Avoidance_RandomDirection();


    /*
     * 防止连续朝同一个方向转
     *
     * 上一次左转
     * 这一次如果随机到左转
     * 就强制改成右转
     */
    if(last_turn == 1 && direction == 0)
    {
        direction = 1;
    }
    else if(last_turn == 2 && direction == 1)
    {
        direction = 0;
    }


    /*======================================================
      左转
    ======================================================*/
    if(direction == 0)
    {
        Motor_Control(-TURN_SPEED, TURN_SPEED);

        HAL_Delay(TURN_TIME);

        last_turn = 1;
    }


    /*======================================================
      右转
    ======================================================*/
    else
    {
        Motor_Control(TURN_SPEED, -TURN_SPEED);

        HAL_Delay(TURN_TIME);

        last_turn = 2;
    }
}


/*==========================================================
  初始化
==========================================================*/
void Avoidance_Init(void)
{
    /*
     * 根据系统启动时间产生不同的初始种子
     *
     * HAL_GetTick() 会随着系统运行变化
     */
    random_seed ^= HAL_GetTick();

    if(random_seed == 0)
    {
        random_seed = 0x12345678;
    }


    last_turn = 0;
}


/*==========================================================
  避障主程序
==========================================================*/
void Avoidance_Run(uint32_t head,
                   uint32_t left,
                   uint32_t right)
{

    /*======================================================
      1. 检查是否存在障碍物
    ======================================================*/

    if((head < FRONT_LIMIT) ||
       (left < SIDE_LIMIT) ||
       (right < SIDE_LIMIT))
    {

        /*--------------------------------------------------
          先停止
        --------------------------------------------------*/
        Motor_Stop();

        HAL_Delay(STOP_TIME);


        /*--------------------------------------------------
          2. 如果障碍物非常近
             增加后退距离
        --------------------------------------------------*/
        if((head > 0U && head < VERY_CLOSE) ||
           (left > 0U && left < VERY_CLOSE) ||
           (right > 0U && right < VERY_CLOSE))
        {
            Motor_Control(-BACK_SPEED, -BACK_SPEED);

            HAL_Delay(BACK_TIME + 100U);
        }
        else
        {
            Motor_Control(-BACK_SPEED, -BACK_SPEED);

            HAL_Delay(BACK_TIME);
        }


        /*--------------------------------------------------
          3. 后退结束后停止
        --------------------------------------------------*/
        Motor_Stop();

        HAL_Delay(50U);


        /*--------------------------------------------------
          4. 随机左转 / 右转
             并防止连续同方向
        --------------------------------------------------*/
        Avoidance_TurnRandom();


        /*--------------------------------------------------
          5. 转向之后向前走一小段
             把车带离原来的障碍物区域
        --------------------------------------------------*/
        Motor_Control(GO_SPEED, GO_SPEED);

        HAL_Delay(ESCAPE_TIME);


        /*--------------------------------------------------
          6. 停止，准备下一次测距
        --------------------------------------------------*/
        Motor_Stop();

        HAL_Delay(30U);
    }


    /*======================================================
      7. 沒有障礙物 → 正常前進
    ======================================================*/
    else
    {
        Motor_Control(GO_SPEED, GO_SPEED);
    }
}